## zephyrproject/boards/stm32_h743xih6_custom_boot/Kconfig.stm32_h743xih6_custom_boot
```kconfig
# Copyright (c) 2020 Teslabs Engineering S.L.
# SPDX-License-Identifier: Apache-2.0

config BOARD_STM32_H743XIH6_CUSTOM_BOOT
	select SOC_STM32H743XX
```

## zephyrproject/boards/stm32_h743xih6_custom_boot/board.yml
```yaml
board:
  name: stm32_h743xih6_custom_boot
  full_name: STM32 Custom board
  vendor: st
  socs:
    - name: stm32h743xx
```

## zephyrproject/build_app/Kconfig/boards/Kconfig
```kconfig
# Load Zephyr board Kconfig descriptions.
osource "E:/zephyr/zephyrproject/boards/stm32_h743xih6_custom/Kconfig"
```

## zephyrproject/build_app/Kconfig/boards/Kconfig.defconfig
```kconfig
# Load Zephyr board defconfig descriptions.
osource "E:/zephyr/zephyrproject/boards/stm32_h743xih6_custom/Kconfig.defconfig"
```

## zephyrproject/build_app/Kconfig/boards/Kconfig.stm32_h743xih6_custom
```kconfig
# Load board Kconfig descriptions.
osource "E:/zephyr/zephyrproject/zephyr/boards/st/stm32_h743xih6_custom/Kconfig.stm32_h743xih6_custom"
```

## zephyrproject/build_app/Kconfig/boards/Kconfig.sysbuild
```kconfig
# Load Sysbuild board Kconfig descriptions.
osource "E:/zephyr/zephyrproject/zephyr/boards/st/stm32_h743xih6_custom/Kconfig.sysbuild"
```

## zephyrproject/build_boot/Kconfig/arch/Kconfig
```kconfig
# Load Zephyr Arch Kconfig descriptions.
osource "E:/zephyr/zephyrproject/zephyr/arch/rx/Kconfig"
osource "E:/zephyr/zephyrproject/zephyr/arch/x86/Kconfig"
osource "E:/zephyr/zephyrproject/zephyr/arch/xtensa/Kconfig"
osource "E:/zephyr/zephyrproject/zephyr/arch/sparc/Kconfig"
osource "E:/zephyr/zephyrproject/zephyr/arch/riscv/Kconfig"
osource "E:/zephyr/zephyrproject/zephyr/arch/posix/Kconfig"
osource "E:/zephyr/zephyrproject/zephyr/arch/openrisc/Kconfig"
osource "E:/zephyr/zephyrproject/zephyr/arch/mips/Kconfig"
osource "E:/zephyr/zephyrproject/zephyr/arch/arm64/Kconfig"
osource "E:/zephyr/zephyrproject/zephyr/arch/arm/Kconfig"
osource "E:/zephyr/zephyrproject/zephyr/arch/arc/Kconfig"
```

## zephyrproject/build_boot/Kconfig/boards/Kconfig.stm32_h743xih6_custom_boot
```kconfig
# Load board Kconfig descriptions.
osource "E:/zephyr/zephyrproject/zephyr/boards/st/stm32_h743xih6_custom_boot/Kconfig.stm32_h743xih6_custom_boot"
```
